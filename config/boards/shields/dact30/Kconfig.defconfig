## config/boards/shields/dact30/Kconfig.defconfig
```kconfig
# Copyright (c) 2022 The ZMK Contributors
# SPDX-License-Identifier: MIT

if SHIELD_DACT30

config ZMK_KEYBOARD_NAME
    default "Dact30 HD-Vf"

endif
```

## config/boards/shields/dact30/Kconfig.shield
```kconfig
# Copyright (c) 2022 The ZMK Contributors
# SPDX-License-Identifier: MIT

config SHIELD_DACT30
   def_bool $(shields_list_contains,dact30)
```
